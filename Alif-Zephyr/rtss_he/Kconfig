## Alif-Zephyr/rtss_he/Kconfig
```kconfig
source "Kconfig.zephyr"

config RTSS_HE_HAS_RTT_SUPPORT
    bool
    default y
    select HAS_SEGGER_RTT
```

## Alif-Zephyr/rtss_hp/Kconfig
```kconfig
source "Kconfig.zephyr"

config RTSS_HP_HAS_RTT_SUPPORT
    bool
    default y
    select HAS_SEGGER_RTT
```
